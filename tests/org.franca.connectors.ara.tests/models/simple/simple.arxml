AUTOSAR XML (schema 4.0)
package /simple
  service interface Simple01
    methods:
      operation callme
        4 x arg:
          arg1: direction=IN
          arg2: direction=IN
          ret1: direction=OUT
          ret2: direction=OUT
