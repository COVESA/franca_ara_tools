AUTOSAR XML (schema 4.0)
package /a1/b2/c3
  impl type TestArStruct: category=STRUCTURE
    4 x element, all with category=TYPE_REFERENCE:
      baseBaseUInt64: implementation-data-type=Int32  # OriginalStructType /a1/b2/c3/TestBaseBaseStruct
      baseUInt32: implementation-data-type=UInt32  # OriginalStructType /a1/b2/c3/TestBaseStruct
      MyUInt8: implementation-data-type=UInt8
      MyUInt16: implementation-data-type=UInt16
  impl type TestBaseBaseStruct: category=STRUCTURE
    element baseBaseUInt64: implementation-data-type=Int32
  impl type TestBaseStruct: category=STRUCTURE
    element baseBaseUInt64: implementation-data-type=Int32  # OriginalStructType /a1/b2/c3/TestBaseBaseStruct
    element baseUInt32: implementation-data-type=UInt32
