AUTOSAR XML (schema 4.0)
package /a1/b2/c3
  service interface TestArInterface
    namespaces:
      symbol props a1
      symbol props b2
      symbol props c3
    methods:
      operation exampleMethod
        arg testStructInstance: type=TestArStruct, direction=IN
  impl type TestArStruct: category=STRUCTURE
    element MyUInt8: implementation-data-type=UInt8
    element MyUInt16: implementation-data-type=UInt16
