AUTOSAR XML (schema 4.0)
package /a1/b2/c3
  service interface ExampleInterface
    methods:
      4 x operation:
        method_{1..4}
  service interface ExampleInterface2
    methods:
      operation method_5
      operation method_6
