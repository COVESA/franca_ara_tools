AUTOSAR XML (schema 4.0)
package /a1/b2/c3
  service interface TestInterface
    namespaces:
      symbol props a1
      symbol props b2
      symbol props c3
    methods:
      operation testMethod
        arg myUInt32: type=UInt32, direction=IN
