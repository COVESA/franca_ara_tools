AUTOSAR XML (schema 4.0)
package /a1/b2/c3
  impl type TestArUnion: category=UNION
    element MyUInt8: implementation-data-type=UInt8
    element MyUInt16: implementation-data-type=UInt16
  impl type TestArUnion2: category=UNION
    element MyUInt8: implementation-data-type=UInt8
