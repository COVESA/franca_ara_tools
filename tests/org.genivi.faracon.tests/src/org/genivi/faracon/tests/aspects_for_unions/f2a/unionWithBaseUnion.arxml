AUTOSAR XML (schema 4.0)
package /a1/b2/c3
  impl type TestArUnion: category=UNION
    4 x element, all with category=TYPE_REFERENCE:
      baseBaseUInt64: implementation-data-type=Int32
      baseUInt32: implementation-data-type=UInt32
      MyUInt8: implementation-data-type=UInt8
      MyUInt16: implementation-data-type=UInt16
  impl type TestBaseBaseUnion: category=UNION
    element baseBaseUInt64: implementation-data-type=Int32
  impl type TestBaseUnion: category=UNION
    element baseBaseUInt64: implementation-data-type=Int32
    element baseUInt32: implementation-data-type=UInt32
