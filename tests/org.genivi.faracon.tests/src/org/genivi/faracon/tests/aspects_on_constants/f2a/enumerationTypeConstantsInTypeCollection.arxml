AUTOSAR XML (schema 4.0)
package /a1/b2/c3
  impl type ExampleEnumeration: category=TYPE_REFERENCE, compu {=X, =Y, =Z}
  impl type ExampleEnumerationVector: category=VECTOR
    element valueType: array-size-semantics=VARIABLE-SIZE, implementation-data-type=ExampleEnumeration
  impl type ExampleStruct: category=STRUCTURE
    element e: implementation-data-type=ExampleEnumeration
  constant specification enumerationArrayTest: value-spec=[/a1/b2/c3/ExampleEnumeration/Z, /a1/b2/c3/ExampleEnumeration/X, /a1/b2/c3/ExampleEnumeration/X, /a1/b2/c3/ExampleEnumeration/Y]  # OriginalLiteralValueType array [enumeration ExampleEnumeration, enumeration ExampleEnumeration, enumeration ExampleEnumeration, enumeration ExampleEnumeration]
  constant specification enumerationInStructTest: value-spec=fields=/a1/b2/c3/ExampleEnumeration/Y  # OriginalLiteralValueType struct {e : enumeration ExampleEnumeration}
  constant specification enumerationTest: value-spec=/a1/b2/c3/ExampleEnumeration/X  # OriginalLiteralValueType enumeration ExampleEnumeration
