AUTOSAR XML (schema 4.0)
package /a1/b2/c3
  service interface ExampleInterface
    namespaces:
      symbol props a1
      symbol props b2
      symbol props c3
package /a1/b2/c3/ExampleInterface
  impl type DoubleIndirectInt32: category=TYPE_REF
    element valueType: implementation-data-type=IndirectInt32
  impl type IndirectInt32: category=TYPE_REF
    element valueType: implementation-data-type=Int32
  18 x constant specification:
    booleanFalseTest: value-spec=false  # OriginalLiteralValueType Boolean
    booleanTrueTest: value-spec=true  # OriginalLiteralValueType Boolean
    byteBufferTest: value-spec=[11, 22, 33]  # OriginalLiteralValueType ByteBuffer
    doubleIndirectInt32Test: value-spec=18839  # OriginalLiteralValueType Int32
    doubleTest: value-spec=3.1415  # OriginalLiteralValueType Double
    emptyStringTest  # OriginalLiteralValueType String
    floatTest: value-spec=1.2345  # OriginalLiteralValueType Float
    indirectInt32Test: value-spec=5423556  # OriginalLiteralValueType Int32
    int16Test: value-spec=-30000  # OriginalLiteralValueType Int16
    int32Test: value-spec=-2000000000  # OriginalLiteralValueType Int32
    int64Test: value-spec=-8111222333444555666  # OriginalLiteralValueType Int64
    int8Test: value-spec=54  # OriginalLiteralValueType Int8
    integerTest: value-spec=576576  # OriginalLiteralValueType Int64
    stringTest: value-spec=string value  # OriginalLiteralValueType String
    uint16Test: value-spec=61234  # OriginalLiteralValueType UInt16
    uint32Test: value-spec=4000000000  # OriginalLiteralValueType UInt32
    uint64Test: value-spec=16111222333444555666  # OriginalLiteralValueType UInt64
    uint8Test: value-spec=200  # OriginalLiteralValueType UInt8
