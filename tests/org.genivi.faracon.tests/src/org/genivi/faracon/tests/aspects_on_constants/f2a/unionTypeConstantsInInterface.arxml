AUTOSAR XML (schema 4.0)
package /a1/b2/c3
  service interface ExampleInterface
    namespaces:
      symbol props a1
      symbol props b2
      symbol props c3
package /a1/b2/c3/ExampleInterface
  impl type ExampleUnion: category=UNION
    element a: implementation-data-type=UInt64
    element b: implementation-data-type=String
    element c: implementation-data-type=DoubleVector
  impl type NestedUnion: category=UNION
    element x: implementation-data-type=ExampleUnion
    element y: implementation-data-type=ByteBuffer
  7 x constant specification:
    nestedUnionTest_x_a: value-spec=fields=fields=111  # OriginalLiteralValueType union {x : union {a : UInt64}}
    nestedUnionTest_x_b: value-spec=fields=fields=aaa  # OriginalLiteralValueType union {x : union {b : String}}
    nestedUnionTest_x_c: value-spec=fields=fields=[1.0, 0.1, 0.01, 0.001]  # OriginalLiteralValueType union {x : union {c : array [Double, Double, Double, Double]}}
    nestedUnionTest_y: value-spec=fields=[1, 2, 4, 8, 16, 32, 64, 128]  # OriginalLiteralValueType union {y : ByteBuffer}
    unionTest_a: value-spec=fields=8555555468  # OriginalLiteralValueType union {a : UInt64}
    unionTest_b: value-spec=fields=vjgcj  # OriginalLiteralValueType union {b : String}
    unionTest_c: value-spec=fields=[1.2345, 0.008, 197.888]  # OriginalLiteralValueType union {c : array [Double, Double, Double]}
