AUTOSAR XML (schema 4.0)
package /a1/b2/c3
  service interface ExampleInterface
    namespaces:
      symbol props a1
      symbol props b2
      symbol props c3
package /a1/b2/c3/ExampleInterface
  6 x impl type:
    ArrayElement: category=STRUCTURE
      element a: implementation-data-type=UInt64
      element b: implementation-data-type=String
      element c: implementation-data-type=Boolean
    ArrayElementVector: category=VECTOR
      element valueType: array-size-semantics=VARIABLE-SIZE, implementation-data-type=ArrayElement
    NamedArrayOfFloatArrays: category=VECTOR
      element valueType: array-size-semantics=VARIABLE-SIZE, implementation-data-type=NamedFloatArray
    NamedFloatArray: category=VECTOR
      element valueType: array-size-semantics=VARIABLE-SIZE, implementation-data-type=Float
    NamedFloatArrayVector: category=VECTOR
      element valueType: array-size-semantics=VARIABLE-SIZE, implementation-data-type=NamedFloatArray
    NamedStructArray: category=VECTOR
      element valueType: array-size-semantics=VARIABLE-SIZE, implementation-data-type=ArrayElement
  9 x constant specification:
    anonymousArrayOfFloatArraysTest: value-spec=[[12.34, 56.78, 98.76], [123.456, 9.99]]  # OriginalLiteralValueType array [array [Float, Float, Float], array [Float, Float]]
    anonymousFloatArrayTest: value-spec=[0.1, 0.2, 0.3, 0.4, 0.5]  # OriginalLiteralValueType array [Float, Float, Float, Float, Float]
    anonymousStructArrayTest: value-spec=[fields=[36, 7izv, false], fields=[95, false], fields=[96, kb, true]]  # OriginalLiteralValueType array [struct {a : UInt64, b : String, c : Boolean}, struct {a : UInt64, b : String, c : Boolean}, struct {a : UInt64, b : String, c : Boolean}]
    emptyNamedFloatArrayTest  # OriginalLiteralValueType array []
    emptyNamedStructArrayTest  # OriginalLiteralValueType array []
    namedArrayOfEmptyFloatArraysTest: value-spec=[, , , ]  # OriginalLiteralValueType array [array [], array [], array [], array []]
    namedArrayOfFloatArraysTest: value-spec=[[1.1, 1.2], [2.1], [3.1, 3.2, 3.3]]  # OriginalLiteralValueType array [array [Float, Float], array [Float], array [Float, Float, Float]]
    namedFloatArrayTest: value-spec=[1.2345, 0.008, 197.888]  # OriginalLiteralValueType array [Float, Float, Float]
    namedStructArrayTest: value-spec=[fields=[111, aaa, true], fields=[222, bbb, false]]  # OriginalLiteralValueType array [struct {a : UInt64, b : String, c : Boolean}, struct {a : UInt64, b : String, c : Boolean}]
