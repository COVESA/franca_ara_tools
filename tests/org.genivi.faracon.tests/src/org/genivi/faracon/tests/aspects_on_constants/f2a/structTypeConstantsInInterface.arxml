AUTOSAR XML (schema 4.0)
package /a1/b2/c3
  service interface ExampleInterface
    namespaces:
      symbol props a1
      symbol props b2
      symbol props c3
package /a1/b2/c3/ExampleInterface
  impl type ArtificialStruct_1: category=STRUCTURE
    element a: implementation-data-type=UInt64
    element b: implementation-data-type=String
    element c: implementation-data-type=DoubleVector
  impl type ExampleStruct: category=STRUCTURE
    element a: implementation-data-type=UInt64
    element b: implementation-data-type=String
    element c: implementation-data-type=DoubleVector
  impl type NestedStruct: category=STRUCTURE
    element x: implementation-data-type=ExampleStruct
    element y: implementation-data-type=ByteBuffer
    element z: implementation-data-type=ExampleStruct
  constant specification nestedStructTest: value-spec=fields=[fields=[111, aaa, [1.0, 0.1, 0.01, 0.001]], [1, 2, 4, 8, 16, 32, 64, 128], fields=[333, ccc, [1234.5789]]]  # OriginalLiteralValueType struct {x : struct {a : UInt64, b : String, c : array [Double, Double, Double, Double]}, y : ByteBuffer, z : struct {a : UInt64, b : String, c : array [Double]}}
  constant specification structTest: value-spec=fields=[8555555468, vjgcj, [1.2345, 0.008, 197.888]]  # OriginalLiteralValueType struct {a : UInt64, b : String, c : array [Double, Double, Double]}
