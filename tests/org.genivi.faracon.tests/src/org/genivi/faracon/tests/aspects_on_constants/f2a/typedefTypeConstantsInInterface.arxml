AUTOSAR XML (schema 4.0)
package /a1/b2/c3
  service interface ExampleInterface
    namespaces:
      symbol props a1
      symbol props b2
      symbol props c3
package /a1/b2/c3/ExampleInterface
  12 x impl type:
    DoubleNestedStructTypedef: category=TYPE_REFERENCE
      element valueType: implementation-data-type=NestedStructTypedef
    DoubleStructTypedef: category=TYPE_REFERENCE
      element valueType: implementation-data-type=StructTypedef
    DoubleUInt8Typedef: category=TYPE_REFERENCE
      element valueType: implementation-data-type=UInt8Typedef
    ExampleStruct: category=STRUCTURE
      element a: implementation-data-type=UInt8Typedef
      element b: implementation-data-type=DoubleUInt8Typedef
      element c: implementation-data-type=TripleUInt8TypedefVector
    NestedStruct: category=STRUCTURE
      element x: implementation-data-type=StructTypedef
      element y: implementation-data-type=DoubleStructTypedef
      element z: implementation-data-type=TripleStructTypedef
    NestedStructTypedef: category=TYPE_REFERENCE
      element valueType: implementation-data-type=NestedStruct
    StructTypedef: category=TYPE_REFERENCE
      element valueType: implementation-data-type=ExampleStruct
    TripleNestedStructTypedef: category=TYPE_REFERENCE
      element valueType: implementation-data-type=DoubleNestedStructTypedef
    TripleStructTypedef: category=TYPE_REFERENCE
      element valueType: implementation-data-type=DoubleStructTypedef
    TripleUInt8Typedef: category=TYPE_REFERENCE
      element valueType: implementation-data-type=DoubleUInt8Typedef
    TripleUInt8TypedefVector: category=VECTOR
      element valueType: array-size-semantics=VARIABLE-SIZE, implementation-data-type=TripleUInt8Typedef
    UInt8Typedef: category=TYPE_REFERENCE
      element valueType: implementation-data-type=UInt8
  9 x constant specification:
    doubleNestedStructTypedefTest: value-spec=fields=[fields=[2, 4, [8, 16, 32]], fields=[3, 9, [27, 81, 243]], fields=[1, 2, [3, 4, 5]]]  # OriginalLiteralValueType struct {x : struct {a : UInt8, b : UInt8, c : array [UInt8, UInt8, UInt8]}, y : struct {a : UInt8, b : UInt8, c : array [UInt8, UInt8, UInt8]}, z : struct {a : UInt8, b : UInt8, c : array [UInt8, UInt8, UInt8]}}
    doubleStructTypedefTest: value-spec=fields=[11, 22, [31, 32, 33]]  # OriginalLiteralValueType struct {a : UInt8, b : UInt8, c : array [UInt8, UInt8, UInt8]}
    doubleUInt8Typedef: value-spec=127  # OriginalLiteralValueType UInt8
    nestedStructTypedefTest: value-spec=fields=[fields=[2, 4, [8, 16, 32]], fields=[3, 9, [27, 81, 243]], fields=[1, 2, [3, 4, 5]]]  # OriginalLiteralValueType struct {x : struct {a : UInt8, b : UInt8, c : array [UInt8, UInt8, UInt8]}, y : struct {a : UInt8, b : UInt8, c : array [UInt8, UInt8, UInt8]}, z : struct {a : UInt8, b : UInt8, c : array [UInt8, UInt8, UInt8]}}
    structTypedefTest: value-spec=fields=[11, 22, [31, 32, 33]]  # OriginalLiteralValueType struct {a : UInt8, b : UInt8, c : array [UInt8, UInt8, UInt8]}
    tripleNestedStructTypedefTest: value-spec=fields=[fields=[2, 4, [8, 16, 32]], fields=[3, 9, [27, 81, 243]], fields=[1, 2, [3, 4, 5]]]  # OriginalLiteralValueType struct {x : struct {a : UInt8, b : UInt8, c : array [UInt8, UInt8, UInt8]}, y : struct {a : UInt8, b : UInt8, c : array [UInt8, UInt8, UInt8]}, z : struct {a : UInt8, b : UInt8, c : array [UInt8, UInt8, UInt8]}}
    tripleStructTypedefTest: value-spec=fields=[11, 22, [31, 32, 33]]  # OriginalLiteralValueType struct {a : UInt8, b : UInt8, c : array [UInt8, UInt8, UInt8]}
    tripleUInt8Typedef: value-spec=13  # OriginalLiteralValueType UInt8
    uint8TypedefTest: value-spec=56  # OriginalLiteralValueType UInt8
