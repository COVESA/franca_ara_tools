AUTOSAR XML (schema 4.0)
package /a1/b2/c3
  service interface ExampleInterface
    namespaces:
      symbol props a1
      symbol props b2
      symbol props c3
package /a1/b2/c3/ExampleInterface
  impl type ExampleEnumeration: category=TYPE_REFERENCE, compu {=X, =Y, =Z}
  impl type ExampleEnumerationVector: category=VECTOR
    element valueType: array-size-semantics=VARIABLE-SIZE, implementation-data-type=ExampleEnumeration
  impl type ExampleStruct: category=STRUCTURE
    element e: implementation-data-type=ExampleEnumeration
  constant specification enumerationArrayTest: value-spec=[/a1/b2/c3/ExampleInterface/ExampleEnumeration/Z, /a1/b2/c3/ExampleInterface/ExampleEnumeration/X, /a1/b2/c3/ExampleInterface/ExampleEnumeration/X, /a1/b2/c3/ExampleInterface/ExampleEnumeration/Y]  # OriginalLiteralValueType array [enumeration ExampleEnumeration, enumeration ExampleEnumeration, enumeration ExampleEnumeration, enumeration ExampleEnumeration]
  constant specification enumerationInStructTest: value-spec=fields=/a1/b2/c3/ExampleInterface/ExampleEnumeration/Y  # OriginalLiteralValueType struct {e : enumeration ExampleEnumeration}
  constant specification enumerationTest: value-spec=/a1/b2/c3/ExampleInterface/ExampleEnumeration/X  # OriginalLiteralValueType enumeration ExampleEnumeration
