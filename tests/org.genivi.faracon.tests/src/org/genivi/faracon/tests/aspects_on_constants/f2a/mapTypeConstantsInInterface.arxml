AUTOSAR XML (schema 4.0)
package /a1/b2/c3
  service interface ExampleInterface
    namespaces:
      symbol props a1
      symbol props b2
      symbol props c3
package /a1/b2/c3/ExampleInterface
  6 x impl type:
    ComplexMap: category=ASSOCIATIVE_MAP
      element keyType: implementation-data-type=StructA
      element valueType: implementation-data-type=StructB
    SimpleMap: category=ASSOCIATIVE_MAP
      element keyType: implementation-data-type=Int16
      element valueType: implementation-data-type=Double
    SimpleMapVector: category=VECTOR
      element valueType: array-size-semantics=VARIABLE-SIZE, implementation-data-type=SimpleMap
    StructA: category=STRUCTURE
      element x: implementation-data-type=UInt64
      element y: implementation-data-type=String
    StructB: category=STRUCTURE
      element x: implementation-data-type=Boolean
      element y: implementation-data-type=ByteBuffer
    SurroundingStruct: category=STRUCTURE
      element s: implementation-data-type=SimpleMap
      element c: implementation-data-type=ComplexMap
  6 x constant specification:
    complexMapTest: value-spec=[fields=[fields=[575, fhj], fields=[true, [1, 2, 3]]], fields=[fields=[123, abc], fields=[false, [5]]]]  # OriginalLiteralValueType map [struct {x : UInt64, y : String} => struct {x : Boolean, y : ByteBuffer}, struct {x : UInt64, y : String} => struct {x : Boolean, y : ByteBuffer}]
    emptyComplexMapTest  # OriginalLiteralValueType map []
    emptySimpleMapTest  # OriginalLiteralValueType map []
    mapsInStructTest: value-spec=fields=[[fields=[23, 3.14], fields=[763, 52.2225], fields=[-987, 0.12345]], [fields=[fields=[575, fhj], fields=[true, [1, 2, 3]]], fields=[fields=[123, abc], fields=[false, [5]]]]]  # OriginalLiteralValueType struct {s : map [Int16 => Double, Int16 => Double, Int16 => Double], c : map [struct {x : UInt64, y : String} => struct {x : Boolean, y : ByteBuffer}, struct {x : UInt64, y : String} => struct {x : Boolean, y : ByteBuffer}]}
    simpleMapTest: value-spec=[fields=[23, 3.14], fields=[763, 52.2225], fields=[-987, 0.12345]]  # OriginalLiteralValueType map [Int16 => Double, Int16 => Double, Int16 => Double]
    simpleMapsArrayTest: value-spec=[[fields=[23, 3.14], fields=[763, 52.2225]], , [fields=[-987, 0.12345]]]  # OriginalLiteralValueType array [map [Int16 => Double, Int16 => Double], map [], map [Int16 => Double]]
