AUTOSAR XML (schema 4.0)
package /a1/b2/c3
  impl type TestStruct: category=STRUCTURE
    element testMember: implementation-data-type=Int32
  impl type simpleMap: category=ASSOCIATIVE_MAP
    element keyType: implementation-data-type=UInt16
    element valueType: implementation-data-type=UInt32
  impl type structMap: category=ASSOCIATIVE_MAP
    element keyType: implementation-data-type=TestStruct
    element valueType: implementation-data-type=UInt32
