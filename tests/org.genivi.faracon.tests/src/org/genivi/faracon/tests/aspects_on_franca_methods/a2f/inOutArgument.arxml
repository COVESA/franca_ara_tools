AUTOSAR XML (schema 4.0)
package /a1/b2/c3
  service interface ExampleInterface
    methods:
      operation exampleMethod
        arg input_argument_1: direction=INOUT
