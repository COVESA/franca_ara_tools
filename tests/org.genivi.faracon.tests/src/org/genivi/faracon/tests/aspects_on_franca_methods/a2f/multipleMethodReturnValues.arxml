AUTOSAR XML (schema 4.0)
package /a1/b2/c3
  service interface ExampleInterface
    methods:
      operation exampleMethod
        4 x arg, all with direction=OUT:
          return_value_{1..4}
