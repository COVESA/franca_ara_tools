AUTOSAR XML (schema 4.0)
package /a1/b2/c3
  service interface ExampleInterface
    namespaces:
      symbol props a1
      symbol props b2
      symbol props c3
    methods:
      operation methodWithInAndOutArguments
        5 x arg:
          input_argument_1: type=UInt32, direction=IN
          input_argument_2: type=Int16, direction=IN
          output_argument_3: type=Int32, direction=OUT
          output_argument_1: type=UInt8, direction=OUT
          output_argument_2: type=UInt16, direction=OUT
