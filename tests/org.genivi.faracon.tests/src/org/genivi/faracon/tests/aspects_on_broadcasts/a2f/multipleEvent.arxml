AUTOSAR XML (schema 4.0)
package /a1/b2/c3
  service interface ExampleInterface
    events:
      data event{1..3}: type=UInt32
