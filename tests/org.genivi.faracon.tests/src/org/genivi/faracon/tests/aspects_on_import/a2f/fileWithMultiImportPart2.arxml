AUTOSAR XML (schema 4.0)
package /a1/b2/c3/d4
  service interface ExampleInterfaceMultiImport
    methods:
      operation testMethod
        arg testStructInE5Arg: type=TestStructInE5, direction=IN
  impl type TestStructInD4: category=STRUCTURE
    element MyUInt32: implementation-data-type=UInt32
package /a1/b2/c3/d4/e5
  impl type TestStructInE5: category=STRUCTURE
    element MyUInt32: implementation-data-type=UInt32
