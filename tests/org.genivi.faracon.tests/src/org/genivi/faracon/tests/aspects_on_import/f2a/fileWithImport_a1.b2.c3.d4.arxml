AUTOSAR XML (schema 4.0)
package /a1/b2/c3/d4
  impl type TestStruct: category=STRUCTURE
    element MyUInt32: implementation-data-type=UInt32
