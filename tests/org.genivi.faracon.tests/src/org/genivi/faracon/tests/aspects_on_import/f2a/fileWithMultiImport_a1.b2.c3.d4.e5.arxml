AUTOSAR XML (schema 4.0)
package /a1/b2/c3/d4/e5
  impl type TestStructInE5: category=STRUCTURE
    element MyUInt32: implementation-data-type=UInt32
