AUTOSAR XML (schema 4.0)
package /a1/b2/c3
  service interface ExampleInterface
    methods:
      operation exampleMethod
        arg enumArg1: type=TestEnum, direction=IN
  impl type TestEnum: category=TYPE_REFERENCE, compu {0x01=enumerator1, 0x02=enumerator2}
