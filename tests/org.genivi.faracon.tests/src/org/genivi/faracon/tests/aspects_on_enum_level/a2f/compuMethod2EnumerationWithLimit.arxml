AUTOSAR XML (schema 4.0)
package /a1/b2/c3
  service interface ExampleInterface
    namespaces:
      symbol props a1
      symbol props b2
      symbol props c3
    methods:
      operation exampleMethod
        arg enumArg1: type=TestEnum, direction=IN
  impl type TestEnum: category=TYPE_REFERENCE, compu {1=enumerator1, 2=enumerator2}
