AUTOSAR XML (schema 4.0)
package /a1/b2/c3
  service interface ExampleInterface
    namespaces:
      symbol props a1
      symbol props b2
      symbol props c3
package /a1/b2/c3/ExampleInterface
  impl type StructWithUserDefinedTypeFields: category=STRUCTURE
    element struct_field: implementation-data-type=UserDefinedStructType
    element enum_field: implementation-data-type=UserDefinedEnumType
  impl type UserDefinedEnumType: category=TYPE_REFERENCE, compu {=enum_literal_1, =enum_literal_2, =enum_literal_3}
  impl type UserDefinedStructType: category=STRUCTURE
    element field_1: implementation-data-type=UInt32
    element field_2: implementation-data-type=Boolean
