AUTOSAR XML (schema 4.0)
package /a1/b2/c3
  service interface ExampleInterface
    namespaces:
      symbol props a1
      symbol props b2
      symbol props c3
package /a1/b2/c3/ExampleInterface
  impl type StructWithIntegerIntervalTypeFields: category=STRUCTURE
    element a: implementation-data-type=Int8
    element b: implementation-data-type=UInt64
    element c: implementation-data-type=Int16
