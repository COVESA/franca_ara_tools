AUTOSAR XML (schema 4.0)
package /a1/b2/c3
  service interface ExampleInterface
    namespaces:
      symbol props a1
      symbol props b2
      symbol props c3
    methods:
      operation methodWithIntegerIntervalTypeArguments
        arg a: type=Int8, direction=IN
        arg b: type=UInt64, direction=IN
        arg c: type=Int16, direction=IN
