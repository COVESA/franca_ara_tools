AUTOSAR XML (schema 4.0)
package /a1/b2/c3
  service interface ExampleInterface
    namespaces:
      symbol props a1
      symbol props b2
      symbol props c3
package /a1/b2/c3/ExampleInterface
  impl type IntegerIntervalTypeA: category=TYPE_REFERENCE
    element valueType: implementation-data-type=Int8
  impl type IntegerIntervalTypeB: category=TYPE_REFERENCE
    element valueType: implementation-data-type=UInt64
  impl type IntegerIntervalTypeC: category=TYPE_REFERENCE
    element valueType: implementation-data-type=Int16
