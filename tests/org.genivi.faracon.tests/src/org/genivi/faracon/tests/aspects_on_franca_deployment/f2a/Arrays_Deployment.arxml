AUTOSAR XML
package /ServiceInterfaces/ServiceInterfaceDeployment
  someip service interface deployment ArrayInterface_Someip: service-interface=ArrayInterface, service-interface-id=4510, service-interface-version={major-version=1, minor-version=2}
