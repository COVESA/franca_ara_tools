AUTOSAR XML
package /serviceIDVersion/v_1_0  # FrancaVersion FInterface: ServiceID_Version v_1_0
  service interface ServiceID_Version
    namespaces:
      symbol props serviceIDVersion
      symbol props v_1_0
package /serviceIDVersion/v_1_0/ServiceInterfaceToDataTypeMappings
  port interface to data type mapping ServiceID_Version_ToDataTypeMapping: data-type-mapping-set=ServiceID_Version_DataTypeMappings, port-interface=ServiceID_Version
package /DataTypeMappingSets
  data type mapping set ServiceID_Version_DataTypeMappings
