AUTOSAR XML
package /ServiceInterfaces/ServiceInterfaceDeployment
  someip service interface deployment StringsInterface_Someip: service-interface=StringsInterface, service-interface-id=4111, service-interface-version={major-version=1, minor-version=2}
    4 x someip field deployment:
      aFixedString1_Someip: field=aFixedString1
        get getAFixedString1: method-id=0, transport-protocol=UDP
        set setAFixedString1: method-id=1, transport-protocol=UDP
      aFixedString2_Someip: field=aFixedString2
        get getAFixedString2: method-id=0, transport-protocol=UDP
        set setAFixedString2: method-id=1, transport-protocol=UDP
      aVariableString1_Someip: field=aVariableString1
        get getAVariableString1: method-id=0, transport-protocol=UDP
        set setAVariableString1: method-id=1, transport-protocol=UDP
      aVariableString2_Someip: field=aVariableString2
        get getAVariableString2: method-id=0, transport-protocol=UDP
        set setAVariableString2: method-id=1, transport-protocol=UDP
