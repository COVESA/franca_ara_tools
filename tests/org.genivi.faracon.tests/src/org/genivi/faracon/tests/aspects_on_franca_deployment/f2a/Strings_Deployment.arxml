AUTOSAR XML
package /ServiceInterfaces/ServiceInterfaceDeployment
  someip service interface deployment StringsInterface_Someip: service-interface=StringsInterface, service-interface-id=4111, service-interface-version={major-version=1, minor-version=2}
    someip field deployment aFixedString_Someip: field=aFixedString
      get getAFixedString: method-id=0, transport-protocol=UDP
      set setAFixedString: method-id=1, transport-protocol=UDP
    someip field deployment aVariableString_Someip: field=aVariableString
      get getAVariableString: method-id=0, transport-protocol=UDP
      set setAVariableString: method-id=1, transport-protocol=UDP
