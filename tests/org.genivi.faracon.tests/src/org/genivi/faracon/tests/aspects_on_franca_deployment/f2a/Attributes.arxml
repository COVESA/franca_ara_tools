AUTOSAR XML
package /packageAttribute/AttributeInterface/v_1_2  # FrancaVersion FInterface: AttributeInterface v_1_2
package /packageAttribute/v_1_2  # FrancaVersion FInterface: AttributeInterface v_1_2
  service interface AttributeInterface
    namespaces:
      symbol props packageAttribute
      symbol props v_1_2
    4 x field, all with has-getter=true, has-notifier=true, has-setter=true:
      boolAttr: type=ADT_Boolean
      enumAttr: type=ADT_ATTR_ENUM
      int16Attr: type=ADT_Int16
      int8Attr: type=ADT_Int8
package /packageAttribute/v_1_2/ServiceInterfaceToDataTypeMappings
  port interface to data type mapping AttributeInterface_ToDataTypeMapping: data-type-mapping-set=AttributeInterface_DataTypeMappings, port-interface=AttributeInterface
package /DataTypes/ApplicationDataTypes
  4 x app type, all with category=VALUE:
    ADT_ATTR_ENUM
    ADT_Boolean
    ADT_Int16
    ADT_Int8
package /DataTypes/ImplementationDataTypes
  impl type IDT_eSOME_IP_ATTR_ENUM: category=TYPE_REFERENCE, base-type=std_uint8_t, compu {0..3=ENUM_KEY_1..ENUM_KEY_4}
package /DataTypeMappingSets
  data type mapping set AttributeInterface_DataTypeMappings
    data-type-maps:
      application-data-type=ADT_ATTR_ENUM, implementation-data-type=IDT_eSOME_IP_ATTR_ENUM
      application-data-type=ADT_Int8, implementation-data-type=Int8
      application-data-type=ADT_Int16, implementation-data-type=Int16
      application-data-type=ADT_Boolean, implementation-data-type=Boolean
package /TransformationProps/TransformationPropsSet
  transformation props set AttributeInterface_TransformationProperties
    4 x ap someip transformation props, all with byte-order=big-endian:
      AttributeInterface_boolAttr_TransformationProps
      AttributeInterface_enumAttr_TransformationProps
      AttributeInterface_int16Attr_TransformationProps
      AttributeInterface_int8Attr_TransformationProps
package /TransformationProps/TransformationPropsToServiceInterfaceMappingSets
  transformation props to service interface element mapping set AttributeInterface_TransformationPropsMappingSet
    4 x transformation props to service interface element mapping:
      AttributeInterface_boolAttr_Mapping: field=boolAttr, transformation-props=AttributeInterface_boolAttr_TransformationProps
      AttributeInterface_enumAttr_Mapping: field=enumAttr, transformation-props=AttributeInterface_enumAttr_TransformationProps
      AttributeInterface_int16Attr_Mapping: field=int16Attr, transformation-props=AttributeInterface_int16Attr_TransformationProps
      AttributeInterface_int8Attr_Mapping: field=int8Attr, transformation-props=AttributeInterface_int8Attr_TransformationProps
