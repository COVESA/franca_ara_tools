AUTOSAR XML
package /ServiceInterfaces/ServiceInterfaceDeployment
  someip service interface deployment AttributeInterface_Someip: service-interface=AttributeInterface, service-interface-id=4510, service-interface-version={major-version=1, minor-version=2}
    4 x someip field deployment:
      boolAttr_Someip: field=boolAttr
        get getBoolAttr: method-id=6, transport-protocol=TCP
        notifier boolAttrNotifier: event-id=45106, transport-protocol=TCP
        set setBoolAttr: method-id=7, transport-protocol=TCP
      enumAttr_Someip: field=enumAttr
        get getEnumAttr: method-id=0, transport-protocol=TCP
        notifier enumAttrNotifier: event-id=45100, transport-protocol=TCP
        set setEnumAttr: method-id=1, transport-protocol=TCP
      int16Attr_Someip: field=int16Attr
        get getInt16Attr: method-id=4, transport-protocol=TCP
        notifier int16AttrNotifier: event-id=45104, transport-protocol=TCP
        set setInt16Attr: method-id=5, transport-protocol=TCP
      int8Attr_Someip: field=int8Attr
        get getInt8Attr: method-id=2, transport-protocol=TCP
        notifier int8AttrNotifier: event-id=45102, transport-protocol=TCP
        set setInt8Attr: method-id=3, transport-protocol=TCP
    4 x someip event group:
      EG_boolAttrNotifier: event-group-id=45106, event=boolAttrNotifier
      EG_enumAttrNotifier: event-group-id=45100, event=enumAttrNotifier
      EG_int16AttrNotifier: event-group-id=45104, event=int16AttrNotifier
      EG_int8AttrNotifier: event-group-id=45102, event=int8AttrNotifier
