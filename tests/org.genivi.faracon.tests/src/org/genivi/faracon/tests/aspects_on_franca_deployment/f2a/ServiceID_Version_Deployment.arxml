AUTOSAR XML
package /ServiceInterfaces/ServiceInterfaceDeployment
  someip service interface deployment ServiceID_Version_Someip: service-interface=ServiceID_Version, service-interface-id=4321, service-interface-version={major-version=1, minor-version=0}
