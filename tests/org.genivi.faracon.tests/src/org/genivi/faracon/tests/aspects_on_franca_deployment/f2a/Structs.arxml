AUTOSAR XML
package /packageStruct/StructInterface/v_1_2  # FrancaVersion FInterface: StructInterface v_1_2
package /packageStruct/v_1_2  # FrancaVersion FInterface: StructInterface v_1_2
  service interface StructInterface
    namespaces:
      symbol props packageStruct
      symbol props v_1_2
package /packageStruct/v_1_2/ServiceInterfaceToDataTypeMappings
  port interface to data type mapping StructInterface_ToDataTypeMapping: data-type-mapping-set=StructInterface_DataTypeMappings, port-interface=StructInterface
package /DataTypeMappingSets
  data type mapping set StructInterface_DataTypeMappings
