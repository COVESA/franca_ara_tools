AUTOSAR XML
package /packageMethod
  service interface MethodInterface
    namespaces:
      symbol props packageMethod
    methods:
      operation methodWithInAndOutArguments: fire-and-forget=false
        5 x arg:
          input_argument_1: type=ADT_UInt32, direction=IN
          input_argument_2: type=ADT_Int16, direction=IN
          output_argument_3: type=ADT_Int32, direction=OUT
          output_argument_1: type=ADT_UInt8, direction=OUT
          output_argument_2: type=ADT_UInt16, direction=OUT
      operation methodWithInAndOutArguments2: fire-and-forget=false
        arg input_argument_1: type=ADT_UInt32, direction=IN
        arg output_argument_3: type=ADT_Int32, direction=OUT
package /packageMethod/ServiceInterfaceToDataTypeMappings
  port interface to data type mapping MethodInterface_ToDataTypeMapping: data-type-mapping-set=MethodInterface_DataTypeMappings, port-interface=MethodInterface
package /TransformationProps/TransformationPropsSet
  transformation props set MethodInterface_TransformationProperties
    ap someip transformation props MethodInterface_methodWithInAndOutArguments2_TransformationProps: byte-order=big-endian
    ap someip transformation props MethodInterface_methodWithInAndOutArguments_TransformationProps: byte-order=big-endian
package /TransformationProps/TransformationPropsToServiceInterfaceMappingSets
  transformation props to service interface element mapping set MethodInterface_TransformationPropsMappingSet
    transformation props to service interface element mapping MethodInterface_methodWithInAndOutArguments2_Mapping: method=methodWithInAndOutArguments2, transformation-props=MethodInterface_methodWithInAndOutArguments2_TransformationProps
    transformation props to service interface element mapping MethodInterface_methodWithInAndOutArguments_Mapping: method=methodWithInAndOutArguments, transformation-props=MethodInterface_methodWithInAndOutArguments_TransformationProps
package /DataTypes/ApplicationDataTypes
  5 x app type, all with category=VALUE:
    ADT_Int16
    ADT_Int32
    ADT_UInt16
    ADT_UInt32
    ADT_UInt8
package /DataTypeMappingSets
  data type mapping set MethodInterface_DataTypeMappings
    data-type-maps:
      application-data-type=ADT_UInt32, implementation-data-type=UInt32
      application-data-type=ADT_Int16, implementation-data-type=Int16
      application-data-type=ADT_Int32, implementation-data-type=Int32
      application-data-type=ADT_UInt8, implementation-data-type=UInt8
      application-data-type=ADT_UInt16, implementation-data-type=UInt16
