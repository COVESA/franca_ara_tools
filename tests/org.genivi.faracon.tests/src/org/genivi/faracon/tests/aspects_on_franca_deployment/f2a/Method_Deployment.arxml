AUTOSAR XML
package /ServiceInterfaces/ServiceInterfaceDeployment
  someip service interface deployment MethodInterface_Someip: service-interface=MethodInterface, service-interface-id=4321
    someip method deployment methodWithInAndOutArguments: method=methodWithInAndOutArguments, method-id=1234, transport-protocol=TCP
    someip method deployment methodWithInAndOutArguments2: method=methodWithInAndOutArguments2, method-id=1122, transport-protocol=UDP
