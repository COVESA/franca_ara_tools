AUTOSAR XML
package /ServiceInterfaces/ServiceInterfaceDeployment
  someip service interface deployment BBInterface_Someip: service-interface=BBInterface, service-interface-id=4111, service-interface-version={major-version=1, minor-version=2}
    someip field deployment aBB1_Someip: field=aBB1
      get getABB1: method-id=10, transport-protocol=UDP
      notifier aBB1Notifier: event-id=12, transport-protocol=UDP
      set setABB1: method-id=11, transport-protocol=UDP
    someip field deployment aBB2_Someip: field=aBB2
      get getABB2: method-id=20, transport-protocol=UDP
      notifier aBB2Notifier: event-id=22, transport-protocol=UDP
      set setABB2: method-id=21, transport-protocol=UDP
    someip method deployment m1: method=m1, method-id=1000, transport-protocol=UDP
