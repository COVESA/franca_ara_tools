AUTOSAR XML
package /packageEventGroup
  service interface EventGroup
    namespaces:
      symbol props packageEventGroup
    events:
      data onChangeEventStatus: type=ADT_UInt8
package /packageEventGroup/ServiceInterfaceToDataTypeMappings
  port interface to data type mapping EventGroup_ToDataTypeMapping: data-type-mapping-set=EventGroup_DataTypeMappings, port-interface=EventGroup
package /TransformationProps/TransformationPropsSet
  transformation props set EventGroup_TransformationProperties
    ap someip transformation props EventGroup_onChangeEventStatus_TransformationProps: byte-order=big-endian
package /TransformationProps/TransformationPropsToServiceInterfaceMappingSets
  transformation props to service interface element mapping set EventGroup_TransformationPropsMappingSet
    transformation props to service interface element mapping EventGroup_onChangeEventStatus_Mapping: event=onChangeEventStatus, transformation-props=EventGroup_onChangeEventStatus_TransformationProps
package /DataTypes/ApplicationDataTypes
  app type ADT_UInt8: category=VALUE
package /DataTypeMappingSets
  data type mapping set EventGroup_DataTypeMappings: data-type-map{application-data-type=ADT_UInt8, implementation-data-type=UInt8}
