AUTOSAR XML
package /packageByteBuffer/v_1_2  # FrancaVersion FInterface: BBInterface v_1_2
  service interface BBInterface
    namespaces:
      symbol props packageByteBuffer
      symbol props v_1_2
    field aBB1: type=ADT_ByteBuffer, has-getter=true, has-notifier=true, has-setter=true
    field aBB2: type=ADT_ByteBuffer, has-getter=true, has-notifier=true, has-setter=true
    methods:
      operation m1: fire-and-forget=false
        arg arg1: type=ADT_ByteBuffer, direction=IN
        arg result1: type=ADT_ByteBuffer, direction=OUT
package /packageByteBuffer/v_1_2/ServiceInterfaceToDataTypeMappings
  port interface to data type mapping BBInterface_ToDataTypeMapping: data-type-mapping-set=BBInterface_DataTypeMappings, port-interface=BBInterface
package /DataTypes/ApplicationDataTypes
  app type ADT_ByteBuffer: category=ARRAY
package /DataTypeMappingSets
  data type mapping set BBInterface_DataTypeMappings: data-type-map{application-data-type=ADT_ByteBuffer, implementation-data-type=ByteBuffer}
package /TransformationProps/TransformationPropsSet
  transformation props set BBInterface_TransformationProperties
    ap someip transformation props BBInterface_aBB1_TransformationProps: byte-order=big-endian
    ap someip transformation props BBInterface_aBB2_TransformationProps: byte-order=big-endian
    ap someip transformation props BBInterface_m1_TransformationProps: byte-order=big-endian
package /TransformationProps/TransformationPropsToServiceInterfaceMappingSets
  transformation props to service interface element mapping set BBInterface_TransformationPropsMappingSet
    transformation props to service interface element mapping BBInterface_aBB1_Mapping: field=aBB1, transformation-props=BBInterface_aBB1_TransformationProps
    transformation props to service interface element mapping BBInterface_aBB2_Mapping: field=aBB2, transformation-props=BBInterface_aBB2_TransformationProps
    transformation props to service interface element mapping BBInterface_m1_Mapping: method=m1, transformation-props=BBInterface_m1_TransformationProps
