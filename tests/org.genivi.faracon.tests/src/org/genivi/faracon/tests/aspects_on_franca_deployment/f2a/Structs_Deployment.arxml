AUTOSAR XML
package /ServiceInterfaces/ServiceInterfaceDeployment
  someip service interface deployment StructInterface_Someip: service-interface=StructInterface, service-interface-id=4520, service-interface-version={major-version=1, minor-version=2}
