AUTOSAR XML
package /ServiceInterfaces/ServiceInterfaceDeployment
  someip service interface deployment EventGroup_Someip: service-interface=EventGroup, service-interface-id=1234
    someip event deployment onChangeEventStatus_Event: event=onChangeEventStatus, event-id=70000
    4 x someip event group:
      EventGroup_30000: event-group-id=30000, event=onChangeEventStatus_Event
      EventGroup_30001: event-group-id=30001, event=onChangeEventStatus_Event
      EventGroup_33000: event-group-id=33000
      EventGroup_33300: event-group-id=33300
