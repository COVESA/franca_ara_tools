AUTOSAR XML
package /packageStrings/v_1_2  # FrancaVersion FInterface: StringsInterface v_1_2
  service interface StringsInterface
    namespaces:
      symbol props packageStrings
      symbol props v_1_2
    field aFixedString: type=ADT_String_789, has-getter=true, has-notifier=false, has-setter=true
    field aVariableString: type=ADT_String_varSize_base2, has-getter=true, has-notifier=false, has-setter=true
package /packageStrings/v_1_2/ServiceInterfaceToDataTypeMappings
  port interface to data type mapping StringsInterface_ToDataTypeMapping: data-type-mapping-set=StringsInterface_DataTypeMappings, port-interface=StringsInterface
package /DataTypes/ApplicationDataTypes
  app type ADT_String_789: category=STRING, sw-text-props={array-size-semantics=FIXED-SIZE, sw-max-text-size=789, base-type=std_uint8_t, sw-fill-character=0}
  app type ADT_String_varSize_base2: category=STRING, sw-text-props={array-size-semantics=VARIABLE-SIZE, base-type=std_uint8_t, sw-fill-character=0}
package /DataTypes/ImplementationDataTypes
  impl type IDT_eSOME_IP_String_789: category=ARRAY
    element IDT_uint8: category=VALUE, array-size=789, array-size-handling=ALL-INDICES-SAME-ARRAY-SIZE, array-size-semantics=FIXED-SIZE, base-type=std_uint8_t
  impl type IDT_eSOME_IP_String_varSize_base2: category=STRUCTURE
    element IDT_eSOME_IP_String_varSize_base2_Size: category=VALUE, base-type=std_uint16_t
    element IDT_eSOME_IP_String_varSize_base2_Payload: category=ARRAY
      element IDT_uint8: category=VALUE, array-size-semantics=VARIABLE-SIZE, base-type=std_uint8_t
package /DataTypeMappingSets
  data type mapping set StringsInterface_DataTypeMappings
    data-type-maps:
      application-data-type=ADT_String_789, implementation-data-type=IDT_eSOME_IP_String_789
      application-data-type=ADT_String_varSize_base2, implementation-data-type=IDT_eSOME_IP_String_varSize_base2
package /TransformationProps/TransformationPropsSet
  transformation props set StringsInterface_TransformationProperties
    ap someip transformation props StringsInterface_aFixedString_TransformationProps: byte-order=big-endian, size-of-string-length-field=0, string-encoding=UTF-16BE
    ap someip transformation props StringsInterface_aVariableString_TransformationProps: byte-order=big-endian, size-of-string-length-field=2, string-encoding=UTF-8
package /TransformationProps/TransformationPropsToServiceInterfaceMappingSets
  transformation props to service interface element mapping set StringsInterface_TransformationPropsMappingSet
    transformation props to service interface element mapping StringsInterface_aFixedString_Mapping: field=aFixedString, transformation-props=StringsInterface_aFixedString_TransformationProps
    transformation props to service interface element mapping StringsInterface_aVariableString_Mapping: field=aVariableString, transformation-props=StringsInterface_aVariableString_TransformationProps
