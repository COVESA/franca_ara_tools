AUTOSAR XML
package /packageStrings/v_1_2  # FrancaVersion FInterface: StringsInterface v_1_2
  service interface StringsInterface
    namespaces:
      symbol props packageStrings
      symbol props v_1_2
    4 x field, all with has-getter=true, has-notifier=false, has-setter=true:
      aFixedString1: type=ADT_String_utf16_789
      aFixedString2: type=ADT_String_utf8_100
      aVariableString1: type=ADT_String_varSize_lenbt2_utf8
      aVariableString2: type=ADT_String_varSize_lenbt1_utf16_max75
package /packageStrings/v_1_2/ServiceInterfaceToDataTypeMappings
  port interface to data type mapping StringsInterface_ToDataTypeMapping: data-type-mapping-set=StringsInterface_DataTypeMappings, port-interface=StringsInterface
package /DataTypes/ApplicationDataTypes
  4 x app type, all with category=STRING:
    ADT_String_utf16_789: sw-text-props={array-size-semantics=FIXED-SIZE, sw-max-text-size=789, base-type=UTF-16, sw-fill-character=0}
    ADT_String_utf8_100: sw-text-props={array-size-semantics=FIXED-SIZE, sw-max-text-size=100, base-type=UTF-8, sw-fill-character=0}
    ADT_String_varSize_lenbt1_utf16_max75: sw-text-props={array-size-semantics=VARIABLE-SIZE, sw-max-text-size=75, base-type=UTF-16, sw-fill-character=0}
    ADT_String_varSize_lenbt2_utf8: sw-text-props={array-size-semantics=VARIABLE-SIZE, base-type=UTF-8, sw-fill-character=0}
package /DataTypes/ImplementationDataTypes
  4 x impl type:
    IDT_eSOME_IP_String_utf16_789: category=ARRAY
      element IDT_uint8: category=VALUE, array-size=789, array-size-handling=ALL-INDICES-SAME-ARRAY-SIZE, array-size-semantics=FIXED-SIZE, base-type=std_uint8_t
    IDT_eSOME_IP_String_utf8_100: category=ARRAY
      element IDT_uint8: category=VALUE, array-size=100, array-size-handling=ALL-INDICES-SAME-ARRAY-SIZE, array-size-semantics=FIXED-SIZE, base-type=std_uint8_t
    IDT_eSOME_IP_String_varSize_lenbt1_utf16_max75: category=STRUCTURE
      element IDT_eSOME_IP_String_varSize_lenbt1_utf16_max75_Size: category=VALUE, base-type=std_uint8_t
      element IDT_eSOME_IP_String_varSize_lenbt1_utf16_max75_Payload: category=ARRAY
        element IDT_uint8: category=VALUE, array-size=75, array-size-semantics=VARIABLE-SIZE, base-type=std_uint8_t
    IDT_eSOME_IP_String_varSize_lenbt2_utf8: category=STRUCTURE
      element IDT_eSOME_IP_String_varSize_lenbt2_utf8_Size: category=VALUE, base-type=std_uint16_t
      element IDT_eSOME_IP_String_varSize_lenbt2_utf8_Payload: category=ARRAY
        element IDT_uint8: category=VALUE, array-size-semantics=VARIABLE-SIZE, base-type=std_uint8_t
package /DataTypeMappingSets
  data type mapping set StringsInterface_DataTypeMappings
    data-type-maps:
      application-data-type=ADT_String_utf16_789, implementation-data-type=IDT_eSOME_IP_String_utf16_789
      application-data-type=ADT_String_utf8_100, implementation-data-type=IDT_eSOME_IP_String_utf8_100
      application-data-type=ADT_String_varSize_lenbt2_utf8, implementation-data-type=IDT_eSOME_IP_String_varSize_lenbt2_utf8
      application-data-type=ADT_String_varSize_lenbt1_utf16_max75, implementation-data-type=IDT_eSOME_IP_String_varSize_lenbt1_utf16_max75
package /TransformationProps/TransformationPropsSet
  transformation props set StringsInterface_TransformationProperties
    4 x ap someip transformation props, all with byte-order=big-endian:
      StringsInterface_aFixedString1_TransformationProps: size-of-string-length-field=0, string-encoding=UTF-16BE
      StringsInterface_aFixedString2_TransformationProps: size-of-string-length-field=0, string-encoding=UTF-8
      StringsInterface_aVariableString1_TransformationProps: size-of-string-length-field=2, string-encoding=UTF-8
      StringsInterface_aVariableString2_TransformationProps: size-of-string-length-field=1, string-encoding=UTF-16LE
package /TransformationProps/TransformationPropsToServiceInterfaceMappingSets
  transformation props to service interface element mapping set StringsInterface_TransformationPropsMappingSet
    4 x transformation props to service interface element mapping:
      StringsInterface_aFixedString1_Mapping: field=aFixedString1, transformation-props=StringsInterface_aFixedString1_TransformationProps
      StringsInterface_aFixedString2_Mapping: field=aFixedString2, transformation-props=StringsInterface_aFixedString2_TransformationProps
      StringsInterface_aVariableString1_Mapping: field=aVariableString1, transformation-props=StringsInterface_aVariableString1_TransformationProps
      StringsInterface_aVariableString2_Mapping: field=aVariableString2, transformation-props=StringsInterface_aVariableString2_TransformationProps
