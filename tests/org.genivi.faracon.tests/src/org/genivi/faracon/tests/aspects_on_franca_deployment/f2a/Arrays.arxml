AUTOSAR XML
package /arrayPackage/ArrayInterface/v_1_2  # FrancaVersion FInterface: ArrayInterface v_1_2
package /arrayPackage/v_1_2  # FrancaVersion FInterface: ArrayInterface v_1_2
  service interface ArrayInterface
    namespaces:
      symbol props arrayPackage
      symbol props v_1_2
package /arrayPackage/v_1_2/ServiceInterfaceToDataTypeMappings
  port interface to data type mapping ArrayInterface_ToDataTypeMapping: data-type-mapping-set=ArrayInterface_DataTypeMappings, port-interface=ArrayInterface
package /DataTypeMappingSets
  data type mapping set ArrayInterface_DataTypeMappings
