AUTOSAR XML (schema 4.0)
package /a1/b2/c3
  impl type BasicTypesStruct: category=STRUCTURE
    15 x element, all with category=TYPE_REFERENCE:
      booleanTest: implementation-data-type=BooleanVector
      doubleTest: implementation-data-type=DoubleVector
      floatTest: implementation-data-type=FloatVector
      int16Test: implementation-data-type=Int16Vector
      int32Test: implementation-data-type=Int32Vector
      int64Test: implementation-data-type=Int64Vector
      int8Test: implementation-data-type=Int8Vector
      stringTest: implementation-data-type=StringVector
      uInt16Test: implementation-data-type=UInt16Vector
      uInt32Test: implementation-data-type=UInt32Vector
      uInt64Test: implementation-data-type=UInt64Vector
      uint8Test: implementation-data-type=UInt8Vector
      byteArrayTest: implementation-data-type=ByteArrayVector
      byteBufferTest: implementation-data-type=ByteBufferVector
      byteVectorTypeTest: implementation-data-type=ByteVectorTypeVector
