AUTOSAR XML (schema 4.0)
package /a1/b2/c3
  impl type BasicTypesStruct: category=STRUCTURE
    14 x element, all with category=TYPE_REFERENCE:
      booleanTest: implementation-data-type=BooleanArray78
      doubleTest: implementation-data-type=DoubleArray9
      floatTest: implementation-data-type=FloatArray73
      int16Test: implementation-data-type=Int16Array16
      int32Test: implementation-data-type=Int32Array95
      int64Test: implementation-data-type=Int64Array94
      int8Test: implementation-data-type=Int8Array27
      integerTest: implementation-data-type=Int64Array53
      stringTest: implementation-data-type=StringArray41
      uInt16Test: implementation-data-type=UInt16Array90
      uInt32Test: implementation-data-type=UInt32Array115
      uInt64Test: implementation-data-type=UInt64Array698
      uint8Test: implementation-data-type=UInt8Array6
      byteBufferTest: implementation-data-type=ByteBufferArray88
