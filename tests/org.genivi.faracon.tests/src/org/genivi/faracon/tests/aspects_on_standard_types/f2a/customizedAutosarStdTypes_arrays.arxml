AUTOSAR XML (schema 4.0)
package /test/customizedStdTypes
  14 x impl type, all with category=ARRAY:
    BooleanArray78
      element valueType: array-size=78, array-size-semantics=FIXED-SIZE, implementation-data-type=Boolean
    ByteBufferArray88
      element valueType: array-size=88, array-size-semantics=FIXED-SIZE, implementation-data-type=ByteBuffer
    DoubleArray9
      element valueType: array-size=9, array-size-semantics=FIXED-SIZE, implementation-data-type=Double
    FloatArray73
      element valueType: array-size=73, array-size-semantics=FIXED-SIZE, implementation-data-type=Float
    Int16Array16
      element valueType: array-size=16, array-size-semantics=FIXED-SIZE, implementation-data-type=Int16
    Int32Array95
      element valueType: array-size=95, array-size-semantics=FIXED-SIZE, implementation-data-type=Int32
    Int64Array53
      element valueType: array-size=53, array-size-semantics=FIXED-SIZE, implementation-data-type=Int64
    Int64Array94
      element valueType: array-size=94, array-size-semantics=FIXED-SIZE, implementation-data-type=Int64
    Int8Array27
      element valueType: array-size=27, array-size-semantics=FIXED-SIZE, implementation-data-type=Int8
    StringArray41
      element valueType: array-size=41, array-size-semantics=FIXED-SIZE, implementation-data-type=String
    UInt16Array90
      element valueType: array-size=90, array-size-semantics=FIXED-SIZE, implementation-data-type=UInt16
    UInt32Array115
      element valueType: array-size=115, array-size-semantics=FIXED-SIZE, implementation-data-type=UInt32
    UInt64Array698
      element valueType: array-size=698, array-size-semantics=FIXED-SIZE, implementation-data-type=UInt64
    UInt8Array6
      element valueType: array-size=6, array-size-semantics=FIXED-SIZE, implementation-data-type=UInt8
