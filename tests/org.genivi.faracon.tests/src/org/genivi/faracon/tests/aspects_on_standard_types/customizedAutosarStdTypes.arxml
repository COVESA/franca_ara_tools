AUTOSAR XML (schema 00045)
standard types defined: Boolean, Double, Float, UInt16, UInt32, UInt64, UInt8
package /test/customizedStdTypes
  8 x impl type:
    ByteArray: category=VECTOR
    ByteBuffer: category=VECTOR
    Int16: category=VALUE
    Int32: category=VALUE
    Int64: category=VALUE
    Int8: category=VALUE
    String: category=STRING
    ByteVectorType: category=VECTOR
