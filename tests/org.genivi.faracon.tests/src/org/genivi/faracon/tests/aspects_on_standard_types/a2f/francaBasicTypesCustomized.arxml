AUTOSAR XML (schema 4.0)
package /a1/b2/c3
  impl type BasicTypesStruct: category=STRUCTURE
    15 x element, all with category=TYPE_REFERENCE:
      booleanTest: implementation-data-type=Boolean
      doubleTest: implementation-data-type=Double
      floatTest: implementation-data-type=Float
      int16Test: implementation-data-type=Int16
      int32Test: implementation-data-type=Int32
      int64Test: implementation-data-type=Int64
      int8Test: implementation-data-type=Int8
      stringTest: implementation-data-type=String
      uInt16Test: implementation-data-type=UInt16
      uInt32Test: implementation-data-type=UInt32
      uInt64Test: implementation-data-type=UInt64
      uint8Test: implementation-data-type=UInt8
      byteArrayTest: implementation-data-type=ByteArray
      byteBufferTest: implementation-data-type=ByteBuffer
      byteVectorTypeTest: implementation-data-type=ByteVectorType
