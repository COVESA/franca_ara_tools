AUTOSAR XML (schema 4.0)
package /test/customizedStdTypes
  15 x impl type, all with category=VECTOR:
    BooleanVector
      element BooleanRef: array-size-semantics=VARIABLE-SIZE, implementation-data-type=Boolean
    ByteArrayVector
      element ByteArrayRef: array-size-semantics=VARIABLE-SIZE, implementation-data-type=ByteArray
    ByteBufferVector
      element ByteBufferRef: array-size-semantics=VARIABLE-SIZE, implementation-data-type=ByteBuffer
    ByteVectorTypeVector
      element ByteVectorTypeRef: array-size-semantics=VARIABLE-SIZE, implementation-data-type=ByteVectorType
    DoubleVector
      element DoubleRef: array-size-semantics=VARIABLE-SIZE, implementation-data-type=Double
    FloatVector
      element FloatRef: array-size-semantics=VARIABLE-SIZE, implementation-data-type=Float
    Int16Vector
      element Int16Ref: array-size-semantics=VARIABLE-SIZE, implementation-data-type=Int16
    Int32Vector
      element Int32Ref: array-size-semantics=VARIABLE-SIZE, implementation-data-type=Int32
    Int64Vector
      element Int64Ref: array-size-semantics=VARIABLE-SIZE, implementation-data-type=Int64
    Int8Vector
      element Int8Ref: array-size-semantics=VARIABLE-SIZE, implementation-data-type=Int8
    StringVector
      element StringRef: array-size-semantics=VARIABLE-SIZE, implementation-data-type=String
    UInt16Vector
      element UInt16Ref: array-size-semantics=VARIABLE-SIZE, implementation-data-type=UInt16
    UInt32Vector
      element UInt32Ref: array-size-semantics=VARIABLE-SIZE, implementation-data-type=UInt32
    UInt64Vector
      element UInt64Ref: array-size-semantics=VARIABLE-SIZE, implementation-data-type=UInt64
    UInt8Vector
      element UInt8Ref: array-size-semantics=VARIABLE-SIZE, implementation-data-type=UInt8
