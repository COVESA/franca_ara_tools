AUTOSAR XML (schema 4.0)
package /a1/b2/c3/v_2_5  # FrancaVersion FInterface: TestInterface v_2_5
  service interface TestInterface
    namespaces:
      4 x symbol props:
        a1
        b2
        c3
        v_2_5
