AUTOSAR XML (schema 4.0)
package /a1/b2/c3/2_5  # FrancaVersion FInterfaceImpl 2.5
  service interface TestInterface
    namespaces:
      4 x symbol props:
        a1
        b2
        c3
        2_5
