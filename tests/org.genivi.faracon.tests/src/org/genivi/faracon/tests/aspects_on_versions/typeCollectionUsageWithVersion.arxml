AUTOSAR XML (schema 4.0)
package /a1/b2/c3
  service interface TestInterface
    namespaces:
      symbol props a1
      symbol props b2
      symbol props c3
    methods:
      operation testMethod
        arg arStructIn: type=TestArStruct, direction=IN
package /a1/b2/c3/2_1  # FrancaVersion FTypeCollectionImpl 2.1
  impl type TestArStruct: category=STRUCTURE
    element MyUInt32: implementation-data-type=UInt32
