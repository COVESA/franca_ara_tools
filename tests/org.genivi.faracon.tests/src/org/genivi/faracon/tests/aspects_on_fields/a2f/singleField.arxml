AUTOSAR XML (schema 4.0)
package /a1/b2/c3
  service interface ExampleInterface
    field testField: has-getter=true, has-notifier=true, has-setter=true, type=UInt8
