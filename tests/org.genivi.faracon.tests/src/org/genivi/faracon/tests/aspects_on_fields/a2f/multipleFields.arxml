AUTOSAR XML (schema 4.0)
package /a1/b2/c3
  service interface ExampleInterface
    namespaces:
      symbol props a1
      symbol props b2
      symbol props c3
    field testField1: type=UInt8, has-getter=true, has-notifier=true, has-setter=true
    field testField2: type=UInt16, has-getter=true, has-notifier=true, has-setter=true
    field testField3: type=UInt32, has-getter=true, has-notifier=true, has-setter=true
