AUTOSAR XML (schema 4.0)
package /a1/b2/c3
  service interface ExampleInterface
    field testField1: has-getter=true, has-notifier=true, has-setter=true, type=UInt8
    field testField2: has-getter=true, has-notifier=true, has-setter=true, type=UInt16
    field testField3: has-getter=true, has-notifier=true, has-setter=true, type=UInt32
