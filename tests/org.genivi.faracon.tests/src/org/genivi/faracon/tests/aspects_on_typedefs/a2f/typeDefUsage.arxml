AUTOSAR XML (schema 4.0)
package /a1/b2/c3
  service interface ExampleInterface
    methods:
      operation testMethod
        arg typeDefIn: type=TestTypeDef, direction=IN
        arg structTypedefIn: type=StructTypedef, direction=IN
  impl type TestTypeDef: category=TYPE_REF
    element testTypeDefSubElement: implementation-data-type=UInt16
  impl type StructTypedef: category=TYPE_REF
    element testStructTypeDefSubElement: implementation-data-type=TestStruct
  impl type TestStruct: category=STRUCTURE
    element testMember: implementation-data-type=UInt32
