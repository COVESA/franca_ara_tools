AUTOSAR XML (schema 4.0)
package /a1/b2/c3
  service interface ExampleInterface
    namespaces:
      symbol props a1
      symbol props b2
      symbol props c3
    methods:
      operation testMethod
        arg typeDefIn: type=TestTypeDef, direction=IN
        arg structTypedefIn: type=StructTypedef, direction=IN
  impl type StructTypedef: category=TYPE_REFERENCE
    element valueType: implementation-data-type=TestStruct
  impl type TestStruct: category=STRUCTURE
    element testMember: implementation-data-type=UInt32
  impl type TestTypeDef: category=TYPE_REFERENCE
    element valueType: implementation-data-type=UInt16
