AUTOSAR XML (schema 4.0)
package /a1/b2/c3
  service interface TestInterface
    methods:
      operation testMethod
        4 x arg, all with direction=IN:
          simpleArrayIn: type=UInt32Vector
          byteArrayArrayIn: type=ByteArrayVector
          byteBufferArrayIn: type=ByteBufferVector
          byteVectorTypeArrayIn: type=ByteVectorTypeVector
