AUTOSAR XML (schema 4.0)
package /a1/b2/c3
  5 x impl type:
    TestStruct: category=STRUCTURE
      5 x element, all with category=TYPE_REFERENCE:
        fixedSizedArray_10_Elements: implementation-data-type=UInt8Array10
        fixedSizedArray_20_Elements: implementation-data-type=UInt8Array20
        explicitlyDynamicallySizedArray: implementation-data-type=UInt8Vector
        implicitlyDynamicallySizedArray: implementation-data-type=UInt8Vector
        nonArrayStructField: implementation-data-type=UInt8
    TestUnion_ExplicitlyDynamicallySizedArray: category=UNION
      element explicitlyDynamicallySizedArray: implementation-data-type=UInt8Vector
      element nonArrayUnionField: implementation-data-type=UInt8
    TestUnion_FixedSizedArray_10_Elements: category=UNION
      element fixedSizedArray_10_Elements: implementation-data-type=UInt8Array10
      element nonArrayUnionField: implementation-data-type=UInt8
    TestUnion_FixedSizedArray_20_Elements: category=UNION
      element fixedSizedArray_20_Elements: implementation-data-type=UInt8Array20
      element nonArrayUnionField: implementation-data-type=UInt8
    TestUnion_ImplicitlyDynamicallySizedArray: category=UNION
      element implicitlyDynamicallySizedArray: implementation-data-type=UInt8Vector
      element nonArrayUnionField: implementation-data-type=UInt8
