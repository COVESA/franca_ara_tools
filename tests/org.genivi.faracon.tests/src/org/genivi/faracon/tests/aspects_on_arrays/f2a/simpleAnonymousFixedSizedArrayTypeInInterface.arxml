AUTOSAR XML (schema 4.0)
package /a1/b2/c3
  service interface ExampleInterface
    namespaces:
      symbol props a1
      symbol props b2
      symbol props c3
    5 x field, all with has-getter=true, has-notifier=true, has-setter=true:
      attribute_explicitlyDynamicallySizedArray: type=UInt8Vector
      attribute_fixedSizedArray_10_Elements: type=UInt8Array10
      attribute_fixedSizedArray_20_Elements: type=UInt8Array20
      attribute_implicitlyDynamicallySizedArray: type=UInt8Vector
      attribute_nonArray: type=UInt8
    methods:
      operation testMethod
        10 x arg:
          fixedSizedArray_10_Elements_inParam: type=UInt8Array10, direction=IN
          fixedSizedArray_20_Elements_inParam: type=UInt8Array20, direction=IN
          explicitlyDynamicallySizedArray_inParam: type=UInt8Vector, direction=IN
          implicitlyDynamicallySizedArray_inParam: type=UInt8Vector, direction=IN
          nonArray_inParam: type=UInt8, direction=IN
          fixedSizedArray_10_Elements_outParam: type=UInt8Array10, direction=OUT
          fixedSizedArray_20_Elements_outParam: type=UInt8Array20, direction=OUT
          explicitlyDynamicallySizedArray_outParam: type=UInt8Vector, direction=OUT
          implicitlyDynamicallySizedArray_outParam: type=UInt8Vector, direction=OUT
          nonArray_outParam: type=UInt8, direction=OUT
package /a1/b2/c3/ExampleInterface
  5 x impl type:
    TestStruct: category=STRUCTURE
      5 x element, all with category=TYPE_REFERENCE:
        fixedSizedArray_10_Elements: implementation-data-type=UInt8Array10
        fixedSizedArray_20_Elements: implementation-data-type=UInt8Array20
        explicitlyDynamicallySizedArray: implementation-data-type=UInt8Vector
        implicitlyDynamicallySizedArray: implementation-data-type=UInt8Vector
        nonArrayStructField: implementation-data-type=UInt8
    TestUnion_ExplicitlyDynamicallySizedArray: category=UNION
      element explicitlyDynamicallySizedArray: implementation-data-type=UInt8Vector
      element nonArrayUnionField: implementation-data-type=UInt8
    TestUnion_FixedSizedArray_10_Elements: category=UNION
      element fixedSizedArray_10_Elements: implementation-data-type=UInt8Array10
      element nonArrayUnionField: implementation-data-type=UInt8
    TestUnion_FixedSizedArray_20_Elements: category=UNION
      element fixedSizedArray_20_Elements: implementation-data-type=UInt8Array20
      element nonArrayUnionField: implementation-data-type=UInt8
    TestUnion_ImplicitlyDynamicallySizedArray: category=UNION
      element implicitlyDynamicallySizedArray: implementation-data-type=UInt8Vector
      element nonArrayUnionField: implementation-data-type=UInt8
