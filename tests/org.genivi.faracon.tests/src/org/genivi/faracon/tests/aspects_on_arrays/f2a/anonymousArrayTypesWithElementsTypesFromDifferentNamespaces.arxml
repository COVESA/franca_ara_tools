AUTOSAR XML (schema 4.0)
package /a1/b2/c3
  service interface ExampleInterface
    namespaces:
      symbol props a1
      symbol props b2
      symbol props c3
    methods:
      operation methodWithUserDefinedTypeArguments
        arg anonymous_array_argument: type=CommonArrayElementStructTypeVector, direction=IN
        arg anonymous_array_argument_2: type=CommonArrayElementStructTypeVector, direction=IN
        arg anonymous_array_argument_3: type=CommonArrayElementEnumerationTypeVector, direction=IN
