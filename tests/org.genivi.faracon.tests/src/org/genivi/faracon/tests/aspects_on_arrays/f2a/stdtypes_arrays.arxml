AUTOSAR XML (schema 4.0)
package /ara/stdtypes
  impl type UInt8Array10: category=ARRAY
    element valueType: array-size=10, array-size-semantics=FIXED-SIZE, implementation-data-type=UInt8
  impl type UInt8Array20: category=ARRAY
    element valueType: array-size=20, array-size-semantics=FIXED-SIZE, implementation-data-type=UInt8
