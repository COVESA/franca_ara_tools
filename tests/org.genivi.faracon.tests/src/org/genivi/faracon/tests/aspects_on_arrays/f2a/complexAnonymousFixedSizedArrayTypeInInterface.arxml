AUTOSAR XML (schema 4.0)
package /a1/b2/c3
  service interface ExampleInterface
    namespaces:
      symbol props a1
      symbol props b2
      symbol props c3
    5 x field, all with has-getter=true, has-notifier=true, has-setter=true:
      attribute_explicitlyDynamicallySizedArray: type=ArrayElementStructTypeVector
      attribute_fixedSizedArray_10_Elements: type=ArrayElementStructTypeArray10
      attribute_fixedSizedArray_20_Elements: type=ArrayElementStructTypeArray20
      attribute_implicitlyDynamicallySizedArray: type=ArrayElementStructTypeVector
      attribute_nonArray: type=ArrayElementStructType
    methods:
      operation testMethod
        10 x arg:
          fixedSizedArray_10_Elements_inParam: type=ArrayElementStructTypeArray10, direction=IN
          fixedSizedArray_20_Elements_inParam: type=ArrayElementStructTypeArray20, direction=IN
          explicitlyDynamicallySizedArray_inParam: type=ArrayElementStructTypeVector, direction=IN
          implicitlyDynamicallySizedArray_inParam: type=ArrayElementStructTypeVector, direction=IN
          nonArray_inParam: type=ArrayElementStructType, direction=IN
          fixedSizedArray_10_Elements_outParam: type=ArrayElementStructTypeArray10, direction=OUT
          fixedSizedArray_20_Elements_outParam: type=ArrayElementStructTypeArray20, direction=OUT
          explicitlyDynamicallySizedArray_outParam: type=ArrayElementStructTypeVector, direction=OUT
          implicitlyDynamicallySizedArray_outParam: type=ArrayElementStructTypeVector, direction=OUT
          nonArray_outParam: type=ArrayElementStructType, direction=OUT
package /a1/b2/c3/ExampleInterface
  9 x impl type:
    ArrayElementStructType: category=STRUCTURE
      element field_a: implementation-data-type=String
      element field_b: implementation-data-type=Boolean
    ArrayElementStructTypeArray10: category=ARRAY
      element valueType: array-size=10, array-size-semantics=FIXED-SIZE, implementation-data-type=ArrayElementStructType
    ArrayElementStructTypeArray20: category=ARRAY
      element valueType: array-size=20, array-size-semantics=FIXED-SIZE, implementation-data-type=ArrayElementStructType
    ArrayElementStructTypeVector: category=VECTOR
      element valueType: array-size-semantics=VARIABLE-SIZE, implementation-data-type=ArrayElementStructType
    TestStruct: category=STRUCTURE
      5 x element, all with category=TYPE_REFERENCE:
        fixedSizedArray_10_Elements: implementation-data-type=ArrayElementStructTypeArray10
        fixedSizedArray_20_Elements: implementation-data-type=ArrayElementStructTypeArray20
        explicitlyDynamicallySizedArray: implementation-data-type=ArrayElementStructTypeVector
        implicitlyDynamicallySizedArray: implementation-data-type=ArrayElementStructTypeVector
        nonArrayStructField: implementation-data-type=ArrayElementStructType
    TestUnion_ExplicitlyDynamicallySizedArray: category=UNION
      element explicitlyDynamicallySizedArray: implementation-data-type=ArrayElementStructTypeVector
      element nonArrayUnionField: implementation-data-type=ArrayElementStructType
    TestUnion_FixedSizedArray_10_Elements: category=UNION
      element fixedSizedArray_10_Elements: implementation-data-type=ArrayElementStructTypeArray10
      element nonArrayUnionField: implementation-data-type=ArrayElementStructType
    TestUnion_FixedSizedArray_20_Elements: category=UNION
      element fixedSizedArray_20_Elements: implementation-data-type=ArrayElementStructTypeArray20
      element nonArrayUnionField: implementation-data-type=ArrayElementStructType
    TestUnion_ImplicitlyDynamicallySizedArray: category=UNION
      element implicitlyDynamicallySizedArray: implementation-data-type=ArrayElementStructTypeVector
      element nonArrayUnionField: implementation-data-type=ArrayElementStructType
