AUTOSAR XML (schema 4.0)
package /a1/b2/c3
  service interface ExampleInterface
    namespaces:
      symbol props a1
      symbol props b2
      symbol props c3
package /a1/b2/c3/ExampleInterface
  4 x impl type:
    ExplicitlyDynamicallySizedArray: category=VECTOR
      element valueType: array-size-semantics=VARIABLE-SIZE, implementation-data-type=UInt8
    FixedSizedArray: category=ARRAY
      element valueType: array-size=27, array-size-semantics=FIXED-SIZE, implementation-data-type=UInt8
    ImplicitlyDynamicallySizedArray: category=VECTOR
      element valueType: array-size-semantics=VARIABLE-SIZE, implementation-data-type=UInt8
    TestStruct: category=STRUCTURE
      element fixedSizedArray: implementation-data-type=FixedSizedArray
      element explicitlyDynamicallySizedArray: implementation-data-type=ExplicitlyDynamicallySizedArray
      element implicitlyDynamicallySizedArray: implementation-data-type=ImplicitlyDynamicallySizedArray
