AUTOSAR XML (schema 4.0)
package /x/y
  impl type CommonArrayElementStructType: category=STRUCTURE
    element field_a: implementation-data-type=String
    element field_b: implementation-data-type=Boolean
package /x/y/z
  impl type CommonArrayElementStructType: category=STRUCTURE
    element field_a: implementation-data-type=String
    element field_b: implementation-data-type=Boolean
