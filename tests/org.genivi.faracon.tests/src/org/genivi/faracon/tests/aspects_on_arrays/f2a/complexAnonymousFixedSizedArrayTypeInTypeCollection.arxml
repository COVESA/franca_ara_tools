AUTOSAR XML (schema 4.0)
package /a1/b2/c3
  9 x impl type:
    ArrayElementStructType: category=STRUCTURE
      element field_a: implementation-data-type=String
      element field_b: implementation-data-type=Boolean
    ArrayElementStructTypeArray10: category=ARRAY
      element valueType: array-size=10, array-size-semantics=FIXED-SIZE, implementation-data-type=ArrayElementStructType
    ArrayElementStructTypeArray20: category=ARRAY
      element valueType: array-size=20, array-size-semantics=FIXED-SIZE, implementation-data-type=ArrayElementStructType
    ArrayElementStructTypeVector: category=VECTOR
      element valueType: array-size-semantics=VARIABLE-SIZE, implementation-data-type=ArrayElementStructType
    TestStruct: category=STRUCTURE
      5 x element, all with category=TYPE_REFERENCE:
        fixedSizedArray_10_Elements: implementation-data-type=ArrayElementStructTypeArray10
        fixedSizedArray_20_Elements: implementation-data-type=ArrayElementStructTypeArray20
        explicitlyDynamicallySizedArray: implementation-data-type=ArrayElementStructTypeVector
        implicitlyDynamicallySizedArray: implementation-data-type=ArrayElementStructTypeVector
        nonArrayStructField: implementation-data-type=ArrayElementStructType
    TestUnion_ExplicitlyDynamicallySizedArray: category=UNION
      element explicitlyDynamicallySizedArray: implementation-data-type=ArrayElementStructTypeVector
      element nonArrayUnionField: implementation-data-type=ArrayElementStructType
    TestUnion_FixedSizedArray_10_Elements: category=UNION
      element fixedSizedArray_10_Elements: implementation-data-type=ArrayElementStructTypeArray10
      element nonArrayUnionField: implementation-data-type=ArrayElementStructType
    TestUnion_FixedSizedArray_20_Elements: category=UNION
      element fixedSizedArray_20_Elements: implementation-data-type=ArrayElementStructTypeArray20
      element nonArrayUnionField: implementation-data-type=ArrayElementStructType
    TestUnion_ImplicitlyDynamicallySizedArray: category=UNION
      element implicitlyDynamicallySizedArray: implementation-data-type=ArrayElementStructTypeVector
      element nonArrayUnionField: implementation-data-type=ArrayElementStructType
