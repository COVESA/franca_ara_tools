AUTOSAR XML (schema 00045)
standard types defined: Boolean, Double, Float, UInt16, UInt32, UInt64, UInt8
package /ara/stdtypes
  8 x impl type:
    ByteArray: category=VECTOR
      element Dim1Element: implementation-data-type=UInt8
    ByteBuffer: category=VECTOR
      element Dim1Element: implementation-data-type=UInt8
    Int16: category=VALUE, base-type=std_int16_t
    Int32: category=VALUE, base-type=std_int32_t
    Int64: category=VALUE, base-type=std_int64_t
    Int8: category=VALUE, base-type=std_int8_t
    String: category=STRING
    ByteVectorType: category=VECTOR
      element Dim1Element: implementation-data-type=UInt8
  13 x base type, all with category=FIXED_LENGTH, base-type-encoding=NONE:
    cpp_bool: base-type-size=8, byte-order=opaque, native-declaration=bool
    cpp_double: base-type-size=64, byte-order=little-endian, native-declaration=double
    cpp_float: base-type-size=32, byte-order=little-endian, native-declaration=float
    std_int16_t: base-type-size=16, byte-order=little-endian, native-declaration=std::int16_t
    std_int32_t: base-type-size=32, byte-order=little-endian, native-declaration=std::int32_t
    std_int64_t: base-type-size=64, byte-order=little-endian, native-declaration=std::int64_t
    std_int8_t: base-type-size=8, byte-order=little-endian, native-declaration=std::int8_t
    std_uint16_t: base-type-size=16, byte-order=little-endian, native-declaration=std::uint16_t
    std_uint32_t: base-type-size=32, byte-order=little-endian, native-declaration=std::uint32_t
    std_uint64_t: base-type-size=64, byte-order=little-endian, native-declaration=std::uint64_t
    std_uint8_t: base-type-size=8, byte-order=little-endian, native-declaration=std::uint8_t
    UTF-8: base-type-size=8, native-declaration=std::uint8_t
    UTF-16: base-type-size=16, byte-order=little-endian, native-declaration=std::uint16_t
